## conf/distro/susan.conf
```bitbake
require conf/distro/poky.conf

DISTRO = "susan"
DISTRO_NAME = "SusanOS (Yocto Scarthgap)"
DISTRO_VERSION = "1.0"

PACKAGE_CLASSES = "package_deb"

INIT_MANAGER = "systemd"

INHERIT += "mender-full"

MENDER_SERVER_URL = ""
MENDER_TENANT_TOKEN = ""

MENDER_STORAGE_DEVICE = "/dev/nvme0n1"
MENDER_STORAGE_DEVICE_BASE = "/dev/nvme0n1p"

# Mender only manages EFI, rootfs A/B, and the persistent data partition.
# The complete first-flash disk layout is defined by wic/recovery-x86-64.wks.in.
MENDER_STORAGE_TOTAL_SIZE_MB = "336400"
MENDER_BOOT_PART_SIZE_MB = "512"
MENDER_DATA_PART_SIZE_MB = "204800"
MENDER_BOOT_PART = "${MENDER_STORAGE_DEVICE_BASE}2"
MENDER_ROOTFS_PART_A = "${MENDER_STORAGE_DEVICE_BASE}4"
MENDER_ROOTFS_PART_B = "${MENDER_STORAGE_DEVICE_BASE}5"
MENDER_DATA_PART = "${MENDER_STORAGE_DEVICE_BASE}7"

ARTIFACTIMG_FSTYPE = "ext4"
WKS_FILE = "recovery-x86-64.wks.in"

# Keep Mender OTA artifacts, but generate the first-flash disk with the custom WKS.
MENDER_FEATURES_DISABLE:append = " mender-growfs-data"
IMAGE_FSTYPES:append = " bootimg wic wic.bmap"
IMAGE_TYPEDEP:wic:append = " bootimg"
IMAGE_FSTYPES:remove = "uefiimg uefiimg.bmap uefiimg.bz2"

IMAGE_FEATURES:append = " package-management"

VOLATILE_LOG_DIR = "no"

PACKAGECONFIG:pn-vim = "${@bb.utils.filter('DISTRO_FEATURES', 'acl selinux', d)} nls"

NVIDIA_DRIVER_VERSION ?= "580.178.04"
CUDA_TOOLKIT_VERSION  ?= "13.0.2"
PREFERRED_VERSION_nvidia-driver-kmod   = "${NVIDIA_DRIVER_VERSION}"
PREFERRED_VERSION_nvidia-compute-libs  = "${NVIDIA_DRIVER_VERSION}"
PREFERRED_VERSION_nvidia-display-libs  = "${NVIDIA_DRIVER_VERSION}"
PREFERRED_VERSION_cuda-toolkit         = "${CUDA_TOOLKIT_VERSION}"

DISTRO_FEATURES:append = " virtualization"

PREFERRED_PROVIDER_virtual/kernel = "linux-cip"

INITRAMFS_IMAGE = "susan-overlay-initramfs"
INITRAMFS_IMAGE_BUNDLE = "1"
```

## conf/layer.conf
```bitbake
BBPATH .= ":${LAYERDIR}"

BBFILES += "${LAYERDIR}/recipes-*/*/*.bb \
            ${LAYERDIR}/recipes-*/*/*.bbappend"

BBFILE_COLLECTIONS += "meta-susan"
BBFILE_PATTERN_meta-susan = "^${LAYERDIR}/"
BBFILE_PRIORITY_meta-susan = "10"

LAYERDEPENDS_meta-susan = "core openembedded-layer networking-layer filesystems-layer"
LAYERRECOMMENDS_meta-susan = "mender"

LICENSE_PATH += "${LAYERDIR}/licenses"

LAYERSERIES_COMPAT_meta-susan = "scarthgap"
```
